## build/Kconfig/arch/Kconfig
```kconfig
# Load Zephyr Arch Kconfig descriptions.
osource "/home/i4why/workspace/zephyrproject/zephyr/arch/rx/Kconfig"
osource "/home/i4why/workspace/zephyrproject/zephyr/arch/x86/Kconfig"
osource "/home/i4why/workspace/zephyrproject/zephyr/arch/xtensa/Kconfig"
osource "/home/i4why/workspace/zephyrproject/zephyr/arch/sparc/Kconfig"
osource "/home/i4why/workspace/zephyrproject/zephyr/arch/riscv/Kconfig"
osource "/home/i4why/workspace/zephyrproject/zephyr/arch/posix/Kconfig"
osource "/home/i4why/workspace/zephyrproject/zephyr/arch/openrisc/Kconfig"
osource "/home/i4why/workspace/zephyrproject/zephyr/arch/mips/Kconfig"
osource "/home/i4why/workspace/zephyrproject/zephyr/arch/arm64/Kconfig"
osource "/home/i4why/workspace/zephyrproject/zephyr/arch/arm/Kconfig"
osource "/home/i4why/workspace/zephyrproject/zephyr/arch/arc/Kconfig"
```

## build/Kconfig/boards/Kconfig.defconfig
```kconfig
# Load Zephyr board defconfig descriptions.
osource "/home/i4why/workspace/zephyrproject/zephyr/boards/nordic/nrf52840dk/Kconfig.defconfig"
```

## build/Kconfig/boards/Kconfig.sysbuild
```kconfig
# Load Sysbuild board Kconfig descriptions.
osource "/home/i4why/workspace/zephyrproject/zephyr/boards/nordic/nrf52840dk/Kconfig.sysbuild"
```
